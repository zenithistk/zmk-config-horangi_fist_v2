## boards/shields/horangi_fist/Kconfig.defconfig
```kconfig
if SHIELD_HORANGI_FIST_LEFT

config ZMK_KEYBOARD_NAME
    default "horangi_fist"

config ZMK_SPLIT_ROLE_CENTRAL
    default y

endif

if SHIELD_HORANGI_FIST_LEFT || SHIELD_HORANGI_FIST_RIGHT

config ZMK_SPLIT
    default y

endif
```

## config/west.yml
```yaml
manifest:
  remotes:
    - name: zmkfirmware
      url-base: https://github.com/zmkfirmware
  projects:
    - name: zmk
      remote: zmkfirmware
      revision: 641514a97db345f499dd50b0360e594270f008fe  # zmk main @ 2026-08-21
      # revision: main
      import: app/west.yml
  self:
    path: config
```
